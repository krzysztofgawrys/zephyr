## soc/st/stm32/stm32l4x/Kconfig.defconfig.stm32l4s9xx
```kconfig
# ST Microelectronics STM32L4S9xx MCU

# Copyright (c) 2019 STMicroelectronics
# SPDX-License-Identifier: Apache-2.0

if SOC_STM32L4S9XX

config NUM_IRQS
	default 95

endif # SOC_STM32L4S9XX
```
